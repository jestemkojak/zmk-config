## config/west.yml
```yaml
manifest:
  remotes:
    - name: zmkfirmware
      url-base: https://github.com/zmkfirmware
  projects:
    - name: zmk
      remote: zmkfirmware
      revision: cf2c46734ddff6bfaf35d7a638c9099185b8e9d2
      import: app/west.yml
  self:
    path: config
```
