## config/boards/shields/ergodone/Kconfig.defconfig
```kconfig
# Copyright (c) 2023 The ZMK Contributors
# SPDX-License-Identifier: MIT

if SHIELD_ERGODONE

config ZMK_KEYBOARD_NAME
    default "Ergodone"

config ZMK_USB
    default y

config I2C
	default y

config ZMK_KSCAN_MATRIX_POLLING
    default y

endif
```

## config/boards/shields/ergodone/Kconfig.shield
```kconfig
# Copyright (c) 2023 The ZMK Contributors
# SPDX-License-Identifier: MIT

config SHIELD_ERGODONE
    def_bool $(shields_list_contains,ergodone)
```
